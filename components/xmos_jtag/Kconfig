## components/xmos_jtag/Kconfig
```kconfig
menu "XMOS JTAG Programmer"

    choice XMOS_JTAG_BACKEND
        prompt "JTAG transport backend"
        default XMOS_JTAG_BACKEND_GPIO
        help
            Select the low-level JTAG transport.

        config XMOS_JTAG_BACKEND_GPIO
            bool "GPIO bit-bang"
            help
                Bit-bang JTAG over GPIO pins. Works on all ESP32 variants.
                Typical throughput: 1-5 MHz TCK depending on chip.

        config XMOS_JTAG_BACKEND_PARLIO
            bool "Parallel IO (PARLIO) with DMA"
            depends on SOC_PARLIO_SUPPORTED
            help
                Use the PARLIO peripheral with DMA for high-speed JTAG.
                Available on ESP32-P4. Up to ~40 MHz TCK.
    endchoice

    config XMOS_JTAG_TCK_FREQ_KHZ
        int "TCK frequency (kHz)"
        default 1000 if XMOS_JTAG_BACKEND_GPIO
        default 10000 if XMOS_JTAG_BACKEND_PARLIO
        range 100 40000
        help
            JTAG clock frequency in kHz.
            GPIO backend: limited by CPU speed, realistic max ~5000.
            PARLIO backend: up to 40000 (40 MHz).

    config XMOS_JTAG_PARLIO_DMA_BUF_SIZE
        int "PARLIO DMA buffer size (bytes)"
        default 4096
        depends on XMOS_JTAG_BACKEND_PARLIO
        help
            Size of each DMA buffer for PARLIO transfers.
            Larger buffers reduce DMA overhead for bulk transfers.

endmenu
```

## example/sdkconfig.defaults
```kconfig
# No target hardcoded -- use: idf.py set-target esp32s3 (or esp32, esp32c3, etc.)
CONFIG_HTTPD_MAX_REQ_HDR_LEN=1024
CONFIG_HTTPD_MAX_URI_LEN=512
# Use PSRAM for large firmware buffer if available
CONFIG_SPIRAM=y
CONFIG_SPIRAM_USE_CAPS_ALLOC=y

# 2 MB app partition (needs >= 4 MB flash): the embedded XMOS flash stubs
# (~235 KB, XS2 + XS3) plus the WiFi stack exceed the default 1 MB app
# partition on esp32.
CONFIG_ESPTOOLPY_FLASHSIZE_4MB=y
CONFIG_PARTITION_TABLE_CUSTOM=y
CONFIG_PARTITION_TABLE_CUSTOM_FILENAME="partitions.csv"
```

## example/sdkconfig.defaults.esp32p4
```kconfig
# ESP32-P4-NANO rev 1.x
CONFIG_ESP32P4_REV_MIN_1=y
CONFIG_ESP32P4_SELECTS_REV_LESS_V3=y

# Ethernet via IP101GRI (RMII)
CONFIG_ETH_USE_ESP32_EMAC=y

# JTAG backend: use the proven GPIO bit-bang backend. The PARLIO/DMA
# backend is faster but unvalidated on hardware (it read IDCODE=0 on a
# real XU208 while GPIO read 0x5633), so default to GPIO until PARLIO is
# confirmed on silicon. Flip to CONFIG_XMOS_JTAG_BACKEND_PARLIO=y to test it.
CONFIG_XMOS_JTAG_BACKEND_GPIO=y

# PSRAM
CONFIG_SPIRAM=y
CONFIG_SPIRAM_USE_CAPS_ALLOC=y
```
